## config/boards/shields/miryoku_xiao/Kconfig.defconfig
```kconfig
# Copyright (c) 2023 The ZMK Contributors
# SPDX-License-Identifier: MIT

if SHIELD_MIRYOKU_XIAO_LEFT || SHIELD_MIRYOKU_XIAO_RIGHT

config ZMK_KEYBOARD_NAME
    default "Miryoku Xiao"

config ZMK_SPLIT
    default y

config ZMK_SPLIT_BLE
    default y

endif # SHIELD_MIRYOKU_XIAO_LEFT || SHIELD_MIRYOKU_XIAO_RIGHT

if SHIELD_MIRYOKU_XIAO_LEFT

config ZMK_SPLIT_ROLE_CENTRAL
    default y

endif # SHIELD_MIRYOKU_XIAO_LEFT 
```

## config/boards/shields/miryoku_xiao/Kconfig.shield
```kconfig
config SHIELD_MIRYOKU_XIAO
    def_bool $(shields_list_contains,miryoku_xiao)

config SHIELD_MIRYOKU_XIAO_LEFT
    def_bool $(shields_list_contains,miryoku_xiao_left)
    select SHIELD_MIRYOKU_XIAO

config SHIELD_MIRYOKU_XIAO_RIGHT
    def_bool $(shields_list_contains,miryoku_xiao_right)
    select SHIELD_MIRYOKU_XIAO 
```

## config/boards/shields/nice/Kconfig.defconfig
```kconfig
if SHIELD_NICE_LEFT
    config ZMK_KEYBOARD_NAME
        default "Miryoku Xiao"
    config ZMK_SPLIT_ROLE_CENTRAL
        default y
endif

if SHIELD_NICE_LEFT || SHIELD_NICE_RIGHT
    config ZMK_SPLIT
        default y
endif
```

## config/boards/shields/nice/Kconfig.shield
```kconfig
config SHIELD_NICE_LEFT
    def_bool $(shields_list_contains,nice_left)
    select SHIELD_NICE

config SHIELD_NICE_RIGHT
    def_bool $(shields_list_contains,nice_right)
    select SHIELD_NICE
```
